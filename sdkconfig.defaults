## sdkconfig.defaults
```kconfig
CONFIG_ESP32_WIFI_NVS_ENABLED=n
CONFIG_SOC_SPIRAM_SUPPORTED=y
CONFIG_BLINK_GPIO=27
CONFIG_BLINK_LED_STRIP=y
CONFIG_ESP_MAIN_TASK_STACK_SIZE=16000
CONFIG_ESP_MINIMAL_SHARED_STACK_SIZE=4048
CONFIG_ESP_SYSTEM_EVENT_TASK_STACK_SIZE=8000
CONFIG_PARTITION_TABLE_SINGLE_APP_LARGE=y
CONFIG_PARTITION_TABLE_CUSTOM_FILENAME="partitions.csv"
CONFIG_PARTITION_TABLE_FILENAME="partitions_singleapp_large.csv"
CONFIG_PARTITION_TABLE_OFFSET=0x8000
CONFIG_PARTITION_TABLE_MD5=y
```
